## doc/hard/LCD/ST_TDDI_TPDriver_v45.00.260402/ST_TDDI_TPDriver_v45.00.260402/touchscreen/Kconfig
```kconfig
#
# Touchscreen driver configuration
#
menuconfig INPUT_TOUCHSCREEN
	bool "Touchscreens"
	help
	  Say Y here, and a list of supported touchscreens will be displayed.
	  This option doesn't affect the kernel.

	  If unsure, say Y.

if INPUT_TOUCHSCREEN


config TOUCHSCREEN_SITRONIX_SPI_TOUCH
	tristate "Sitronix SPI I/F Multi-Touch Controller"
	depends on SPI
	---help---
	Say Y here if you have a Sitronix multitouch panel.

	  If unsure, say N.

	  To compile this driver as a module, choose M here: the
	  module will be called sitronix_ts.c

endif
```
