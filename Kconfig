## Kconfig
```kconfig
menu "Ameba River"

config AMEBA_RIVER_EN
    bool "Enable ameba-river application"
    default y

config RIVER_ORVIBO_CLIENT_EN
    bool "Enable Orvibo realtime voice client"
    default y
    help
      Build the Orvibo voice-client mainline. The first external wire
      contract is compatible with the XiaoZhi websocket protocol, but the
      firmware architecture is Orvibo-owned.

config RIVER_ORVIBO_OTA_URL
    string "Orvibo access OTA/config URL"
    default "https://api.tenclass.net/xiaozhi/ota/"
    depends on RIVER_ORVIBO_CLIENT_EN
    help
      XiaoZhi-compatible OTA endpoint used to fetch websocket url/token/version
      and activation instructions before opening the realtime audio channel.

config RIVER_ORVIBO_WS_URL
    string "Orvibo fallback websocket URL"
    default ""
    depends on RIVER_ORVIBO_CLIENT_EN
    help
      Optional static fallback websocket endpoint. Leave this empty to require
      OTA/config before the realtime channel is opened. If you explicitly set a
      websocket URL here, the client can use it directly; when the target
      server has auth enabled, pair it with RIVER_ORVIBO_WS_TOKEN.

config RIVER_ORVIBO_WS_TOKEN
    string "Orvibo fallback websocket token"
    default ""
    depends on RIVER_ORVIBO_CLIENT_EN
    help
      Optional static websocket token for auth-enabled deployments. Leave empty
      when the explicitly configured fallback websocket server accepts
      unauthenticated connections.

config RIVER_ORVIBO_WS_SUBPROTOCOL
    string "Orvibo websocket subprotocol"
    default ""
    depends on RIVER_ORVIBO_CLIENT_EN
    help
      Optional Sec-WebSocket-Protocol value for the realtime connection. Leave
      empty to match the XiaoZhi reference clients, which do not request a
      websocket subprotocol.

config RIVER_ORVIBO_PROTOCOL_VERSION
    int "Orvibo websocket binary protocol version"
    range 1 3
    default 1
    depends on RIVER_ORVIBO_CLIENT_EN
    help
      Default to protocol version 1 for direct XiaoZhi-compatible websocket
      interoperability. In this mode binary websocket frames carry raw Opus
      packets without the v2/v3 wrapper. OTA/config can still override this
      when the target deployment explicitly returns a newer websocket version.

config RIVER_ORVIBO_SERVER_WAKE_TEXT
    string "Orvibo server wake text"
    default "你好小智"
    depends on RIVER_ORVIBO_CLIENT_EN
    help
      Text sent in the XiaoZhi-compatible `listen detect` control message after
      the local wake-word path triggers. This is intentionally decoupled from
      the protected local KWS implementation so the branch can preserve the
      current on-device wake phrase while still matching the target server's
      expected wakeup-word semantics.

config RIVER_ORVIBO_DEVICE_ID
    string "Orvibo fixed Device-Id"
    default ""
    depends on RIVER_ORVIBO_CLIENT_EN
    help
      Optional stable Device-Id used for OTA/config and activation. Leave empty
      to derive the identity from the runtime STA MAC. On empty-efuse boards the
      runtime STA MAC can change between boots, so setting this to a stable
      MAC-format value keeps server binding from drifting across reboots.

config RIVER_ORVIBO_ACTIVATION_SERIAL_NUMBER
    string "Orvibo optional activation serial number"
    default ""
    depends on RIVER_ORVIBO_CLIENT_EN
    help
      Optional XiaoZhi-compatible v2 activation serial number. Leave empty to
      use the default v1/no-serial activation flow. When this and
      RIVER_ORVIBO_ACTIVATION_HMAC_KEY are both set, OTA and activation
      requests use Activation-Version 2 and send a Serial-Number header.

config RIVER_ORVIBO_ACTIVATION_HMAC_KEY
    string "Orvibo optional activation HMAC key"
    default ""
    depends on RIVER_ORVIBO_CLIENT_EN
    help
      Optional XiaoZhi-compatible v2 activation HMAC key. It is used as raw
      string bytes for HMAC-SHA256(challenge), matching py-xiaozhi's local
      efuse.json behavior. Leave empty to keep the default v1/no-serial
      activation payload.

config RIVER_DIAG_CMD_EN
    bool "Enable river monitor command"
    default y

config RIVER_AUDIO_ECHO_DEBUG_EN
    bool "Build board audio echo debug path"
    default n
    help
      Build the standalone board audio echo loopback path and related
      monitor commands. Keep disabled for the normal wake -> Orvibo
      product flow to avoid carrying extra debug-only code and strings
      in the firmware image.

choice RIVER_LOG_DEFAULT_LEVEL
    prompt "Default river log level"
    default RIVER_LOG_LEVEL_INFO

config RIVER_LOG_LEVEL_ERROR
    bool "ERROR"

config RIVER_LOG_LEVEL_WARN
    bool "WARN"

config RIVER_LOG_LEVEL_INFO
    bool "INFO"

config RIVER_LOG_LEVEL_DEBUG
    bool "DEBUG"

endchoice

config RIVER_AUDIO_ECHO_AUTOSTART
    bool "Autostart board audio echo at boot"
    default n
    depends on RIVER_AUDIO_ECHO_DEBUG_EN

config RIVER_AUDIO_ECHO_DIAG_DEFAULT_ON
    bool "Enable audio echo diagnostics by default"
    default n
    depends on RIVER_AUDIO_ECHO_DEBUG_EN

choice RIVER_VOICE_PREPROC_BACKEND
    prompt "Local voice pre-processing backend"
    default RIVER_VOICE_PREPROC_FIXED_DSB

config RIVER_VOICE_PREPROC_FIXED_DSB
    bool "Fixed delay-and-sum beamformer"

endchoice

config RIVER_VOICE_DSB_SECONDARY_DELAY_SAMPLES
    int "Fixed DSB secondary-mic delay in samples"
    range 0 8
    default 0

config RIVER_VOICE_DSB_PRIMARY_ONLY
    bool "Use primary mic only for fixed DSB output"
    default n
    help
      Use the primary mic as the fixed-DSB mono output. This is useful on
      bring-up boards where the secondary mic polarity, placement, or channel
      map may cancel speech when the two channels are averaged directly.

config RIVER_VOICE_CAPTURE_PATH_SWEEP_EN
    bool "Run temporary DMIC capture path sweep at boot"
    default n
    help
      Temporarily scan DMIC DATA0..DATA3 at boot before the Orvibo audio
      service opens its normal capture path. Each candidate opens its own
      AudioRecord instance, captures a short window, prints per-channel peak
      metrics, then closes the instance. Disable after board routing is found.

config RIVER_VOICE_CAPTURE_PATH_SWEEP_FRAMES
    int "Temporary DMIC capture path sweep measured frames"
    range 8 256
    default 96
    depends on RIVER_VOICE_CAPTURE_PATH_SWEEP_EN

config RIVER_VOICE_CAPTURE_PATH_SWEEP_WARMUP_FRAMES
    int "Temporary DMIC capture path sweep warmup frames"
    range 0 64
    default 8
    depends on RIVER_VOICE_CAPTURE_PATH_SWEEP_EN

config RIVER_VOICE_CAPTURE_PATH_SWEEP_START_DELAY_MS
    int "Temporary DMIC capture path sweep start delay in ms"
    range 0 10000
    default 0
    depends on RIVER_VOICE_CAPTURE_PATH_SWEEP_EN
    help
      Delay before the temporary boot-time sweep starts. This gives a serial
      monitor time to attach after download/reset so the early sweep logs are
      not missed.

choice RIVER_VOICE_PREPROC_PROFILE
    prompt "Local voice pre-processing profile"
    default RIVER_VOICE_PREPROC_PROFILE_ASR_MAINLINE

config RIVER_VOICE_PREPROC_PROFILE_ASR_MAINLINE
    bool "ASR mainline"

config RIVER_VOICE_PREPROC_PROFILE_FIXED_DSB_WEBRTC_AECM
    bool "Fixed DSB + WebRTC AECM experiment"
    depends on RIVER_WEBRTC_AECM_EXPERIMENT_EN

endchoice

config RIVER_WEBRTC_AECM_EXPERIMENT_EN
    bool "Enable WebRTC AECM experiment assets"
    default n
    help
      Build-time gate for the preserved WebRTC AECM experiment path.
      Keep disabled for the stable ASR baseline. Enable only on the
      dedicated AEC experiment branch/profile.

config RIVER_WEBRTC_AECM_ECHO_MODE
    int "WebRTC AECM echo mode"
    range 0 4
    default 4
    depends on RIVER_WEBRTC_AECM_EXPERIMENT_EN

config RIVER_WEBRTC_AECM_DELAY_MS
    int "WebRTC AECM initial delay hint in milliseconds"
    range 0 200
    default 40
    depends on RIVER_WEBRTC_AECM_EXPERIMENT_EN

config RIVER_WEBRTC_AECM_REF_ENTER_PEAK
    int "WebRTC AECM reference active enter peak"
    range 1 32767
    default 128
    depends on RIVER_WEBRTC_AECM_EXPERIMENT_EN

config RIVER_WEBRTC_AECM_REF_EXIT_PEAK
    int "WebRTC AECM reference active exit peak"
    range 1 32767
    default 64
    depends on RIVER_WEBRTC_AECM_EXPERIMENT_EN

config RIVER_WEBRTC_AECM_REF_STABLE_FRAMES
    int "WebRTC AECM reference enter stable frames"
    range 1 32
    default 3
    depends on RIVER_WEBRTC_AECM_EXPERIMENT_EN

config RIVER_WEBRTC_AECM_REF_HANGOVER_FRAMES
    int "WebRTC AECM reference exit hangover frames"
    range 1 64
    default 8
    depends on RIVER_WEBRTC_AECM_EXPERIMENT_EN

config RIVER_WEBRTC_AECM_REF_ACTIVE_WINDOW_FRAMES
    int "WebRTC AECM reference activity window frames"
    range 1 32
    default 8
    depends on RIVER_WEBRTC_AECM_EXPERIMENT_EN

choice RIVER_VOICE_DETECTOR_BACKEND
    prompt "Local voice detector backend"
    default RIVER_VOICE_DETECTOR_SILERO_VAD

config RIVER_VOICE_DETECTOR_SILERO_VAD
    bool "Silero VAD"

endchoice

config RIVER_SILERO_VAD_TENSOR_ARENA_KB
    int "Silero VAD tensor arena size in KB"
    range 64 1024
    default 256
    depends on RIVER_VOICE_DETECTOR_SILERO_VAD

config RIVER_SILERO_VAD_SPEECH_THRESHOLD_Q15
    int "Silero VAD speech enter threshold in q15"
    range 1 32767
    default 7000
    depends on RIVER_VOICE_DETECTOR_SILERO_VAD

config RIVER_SILERO_VAD_SILENCE_THRESHOLD_Q15
    int "Silero VAD speech exit threshold in q15"
    range 1 32767
    default 2500
    depends on RIVER_VOICE_DETECTOR_SILERO_VAD

config RIVER_SILERO_VAD_HANGOVER_FRAMES
    int "Silero VAD hangover decisions"
    range 0 64
    default 10
    depends on RIVER_VOICE_DETECTOR_SILERO_VAD

config RIVER_SILERO_VAD_EMA_SHIFT
    int "Silero VAD probability EMA shift"
    range 0 6
    default 0
    depends on RIVER_VOICE_DETECTOR_SILERO_VAD

config RIVER_VOICE_CAPABILITY_KWS
    bool "Enable local wake-word sidepath"
    default y
    help
      Enables the wake-stage local KWS sidepath on top of the current
      fixed_dsb mono stream. When enabled, the active voice profile exposes
      the KWS capability and the board runs a local DS-CNN wake-word model.

choice RIVER_KWS_MODEL_VARIANT
    prompt "Wake-word KWS embedded model variant"
    default RIVER_KWS_MODEL_VARIANT_BASELINE
    depends on RIVER_VOICE_CAPABILITY_KWS

config RIVER_KWS_MODEL_VARIANT_BASELINE
    bool "Current baseline embedded model"
    help
      Keep the repository baseline embedded DS-CNN wake-word model.

config RIVER_KWS_MODEL_VARIANT_FP32_EXPERIMENTAL
    bool "BC-ResNet V3 FP32 experimental model"
    help
      Use the larger float32 BC-ResNet V3 model exported from
      /root/kws-training-pro/models/bc_resnet_iteration3/bc_resnet_v3_fp32.tflite.
      This profile is intended for on-board arena/CPU bring-up and should
      be validated with board-recording-derived thresholds before promotion.

config RIVER_KWS_MODEL_VARIANT_ROUND6_TARGETED_EXPERIMENTAL
    bool "Round6 targeted student experimental model"
    help
      Use the round6 targeted DS-CNN student exported from
      /root/river-openwakeword-lab. This is an engineering smoke-test
      variant for the DS-CNN branch and is not yet a deploy-ready model.

config RIVER_KWS_MODEL_VARIANT_STUDENT_BC_RESNET_NANO_V2_FP32_DEBUG
    bool "Student BC-ResNet nano v2 FP32 debug model"
    help
      Use the parallel FP32 debug bundle exported from
      /root/kws-trainint/artifacts/exports/student_bc_resnet_nano_v2.
      This variant is reserved for board/local parity work on the
      `40x101`, `n_fft=400`, centered log-mel frontend so the lighter
      BC-ResNet nano branch can be deployment-checked without replacing the
      current mainline chain.

config RIVER_KWS_MODEL_VARIANT_STUDENT_DSCNN_TINY_V2_FP32_DEBUG
    bool "Student DS-CNN tiny v2 FP32 debug model"
    help
      Use the parallel FP32 debug bundle exported from
      /root/kws-trainint/artifacts/exports/student_dscnn_tiny_v2.
      This variant is reserved for board/local parity work on the
      `40x101`, `n_fft=400`, centered log-mel frontend so the smallest
      current student bring-up model can be board-profiled without
      disturbing the mainline chain.

config RIVER_KWS_MODEL_VARIANT_STUDENT_DSCNN_TINY_V2_INT8_DEBUG
    bool "Student DS-CNN tiny v2 INT8 debug model"
    help
      Use the parallel INT8 deployment bundle exported from
      /root/kws-trainint/artifacts/exports/student_dscnn_tiny_v2.
      This variant is reserved for board/local parity work and board-side
      realtime probing on the `40x101`, `n_fft=400`, centered log-mel
      frontend, while keeping the existing FP32 debug path intact for
      quantization-vs-deployment triage.

config RIVER_KWS_MODEL_VARIANT_STUDENT_DSCNN_SMALL_V2_FP32_DEBUG
    bool "Student DS-CNN small v2 FP32 debug model"
    help
      Use the parallel FP32 debug bundle exported from
      /root/kws-trainint/artifacts/exports/student_dscnn_small_v2.
      This variant is reserved for board/local parity work on the
      `40x101`, `n_fft=400`, centered log-mel frontend so the next
      DS-CNN candidate can be board-profiled without replacing the
      current mainline chain.

config RIVER_KWS_MODEL_VARIANT_STUDENT_CONV_RESNET_ED_NANO_V1_FP32_DEBUG
    bool "Student Conv-ResNet-ED nano v1 FP32 debug model"
    help
      Use the parallel FP32 debug bundle exported from
      /root/kws-trainint/artifacts/exports/student_conv_resnet_ed_nano_v1.
      This variant is reserved for board/local parity work on the
      `40x101`, `n_fft=400`, centered log-mel frontend so the lighter
      kernel-aware Conv-ResNet-ED route can be deployment-checked
      without replacing the current mainline chain.

config RIVER_KWS_MODEL_VARIANT_STUDENT_CONV_RESNET_ED_NANO_CURRENT_TEACHER_A_V2_FP32_DEBUG
    bool "Student Conv-ResNet-ED nano current-teacher-a v2 FP32 debug model"
    help
      Use the parallel FP32 debug bundle exported from
      /root/kws-trainint/artifacts/exports/student_conv_resnet_ed_nano_current_teacher_a_v2.
      This variant keeps the current `40x101`, `n_fft=400`, centered log-mel
      frontend and same conv-only resolver path as the deployed nano v1 while
      promoting the lower-risk teacher-a refresh candidate for board-side A/B
      validation.

config RIVER_KWS_MODEL_VARIANT_STUDENT_CONV_RESNET_ED_TINY_V1_FP32_DEBUG
    bool "Student Conv-ResNet-ED tiny v1 FP32 debug model"
    help
      Use the parallel FP32 debug bundle exported from
      /root/kws-trainint/artifacts/exports/student_conv_resnet_ed_tiny_v1.
      This variant is reserved for board/local parity work on the
      `40x101`, `n_fft=400`, centered log-mel frontend so the new
      kernel-aware Conv-ResNet-ED route can be deployment-checked
      without replacing the current mainline chain.

config RIVER_KWS_MODEL_VARIANT_STUDENT_CONV_RESNET_ED_TINY_V1_INT8_DEBUG
    bool "Student Conv-ResNet-ED tiny v1 INT8 debug model"
    help
      Use the parallel INT8 deployment bundle exported from
      /root/kws-trainint/artifacts/exports/student_conv_resnet_ed_tiny_v1.
      This variant is reserved for board/local parity work and board-side
      realtime probing on the `40x101`, `n_fft=400`, centered log-mel
      frontend, while keeping the matching FP32 debug path intact for
      quantization-vs-deployment triage.

config RIVER_KWS_MODEL_VARIANT_STUDENT_BC_RESNET_TINY_V2_FP32_DEBUG
    bool "Student BC-ResNet tiny v2 FP32 debug model"
    help
      Use the parallel FP32 debug bundle exported from
      /root/kws-trainint/artifacts/exports/student_bc_resnet_tiny_v2.
      This variant is reserved for board/local parity work on the
      `40x101`, `n_fft=400`, centered log-mel frontend and must not
      replace the current mainline production or FP32 bring-up chain.

config RIVER_KWS_MODEL_VARIANT_STUDENT_BC_RESNET_TINY_V2_INT8_DEBUG
    bool "Student BC-ResNet tiny v2 INT8 debug model"
    help
      Use the parallel INT8 deployment bundle exported from
      /root/kws-trainint/artifacts/exports/student_bc_resnet_tiny_v2.
      This variant is reserved for board/local parity work and board-side
      realtime probing on the `40x101`, `n_fft=400`, centered log-mel
      frontend, while keeping the existing FP32 debug path intact for
      quantization-vs-deployment triage.

endchoice

config RIVER_KWS_LEGACY_MODEL_COMPAT_EN
    bool "Build legacy KWS model compatibility ops"
    default n
    depends on RIVER_VOICE_CAPABILITY_KWS
    help
      Build legacy KWS operator compatibility for older embedded models
      that still require ops such as `MEAN` and `FULLY_CONNECTED`.
      Keep this disabled for the current no-MEAN baseline so unused op
      registrations and legacy-only strings stay out of the default image.

config RIVER_KWS_MEAN_PATCH_EN
    bool "Build temporary KWS MEAN patch"
    default n
    depends on RIVER_KWS_LEGACY_MODEL_COMPAT_EN
    depends on RIVER_VOICE_CAPABILITY_KWS
    help
      Build the project-side KWS MEAN registration patch used only for
      legacy embedded models that still need MEAN bring-up workarounds.
      Disable this when moving to a no-MEAN KWS model so the patch code
      stays out of the image and out of the mainline code path.

config RIVER_KWS_TENSOR_ARENA_KB
    int "Wake-word KWS tensor arena size in KB"
    range 32 16384
    default 160
    depends on RIVER_VOICE_CAPABILITY_KWS

config RIVER_KWS_SCORE_THRESHOLD_Q15
    int "Wake-word KWS trigger threshold in q15"
    range 1 32767
    default 27852
    depends on RIVER_VOICE_CAPABILITY_KWS

config RIVER_KWS_TRIGGER_HOLD_FRAMES
    int "Wake-word KWS consecutive trigger frames"
    range 1 8
    default 2
    depends on RIVER_VOICE_CAPABILITY_KWS

config RIVER_KWS_COOLDOWN_MS
    int "Wake-word KWS cooldown in milliseconds"
    range 0 10000
    default 1800
    depends on RIVER_VOICE_CAPABILITY_KWS

config RIVER_KWS_GATE_FALLBACK_EN
    bool "Wake-word KWS VAD gate fallback trigger"
    default y
    depends on RIVER_VOICE_CAPABILITY_KWS
    help
      Allow the VAD gate close path to emit a wake-word trigger from the
      best score observed inside the speech gate when no consecutive main
      threshold trigger was latched. Disable this for conservative
      false-trigger triage so wake emission requires consecutive
      RIVER_KWS_SCORE_THRESHOLD_Q15 hits.

config RIVER_KWS_LOG_PERIOD_MS
    int "Wake-word KWS status log period in milliseconds"
    range 100 10000
    default 1000
    depends on RIVER_VOICE_CAPABILITY_KWS

config RIVER_KWS_INFERENCE_STRIDE_FRAMES
    int "Wake-word KWS inference stride in mel frames"
    range 1 32
    default 2
    depends on RIVER_VOICE_CAPABILITY_KWS

config RIVER_KWS_VAD_PRE_ROLL_MS
    int "Wake-word KWS VAD-gated pre-roll in milliseconds"
    range 0 1000
    default 320
    depends on RIVER_VOICE_CAPABILITY_KWS

config RIVER_KWS_PRE_ROLL_FLUSH_MAX_FRAMES
    int "Wake-word KWS maximum pre-roll frames flushed into the worker"
    range 1 64
    default 8
    depends on RIVER_VOICE_CAPABILITY_KWS

config RIVER_KWS_INPUT_QUEUE_FRAMES
    int "Wake-word KWS worker queue capacity in frames"
    range 8 128
    default 64
    depends on RIVER_VOICE_CAPABILITY_KWS

config RIVER_KWS_DIAG_VERBOSE_EN
    bool "Wake-word KWS detailed diagnostic logs"
    default n
    depends on RIVER_VOICE_CAPABILITY_KWS
    help
      Emit extra per-inference or repeated-pattern diagnostic logs that
      expose pre-quant feature hash, quantized input hash, raw model
      output, and repeated-value streaks for board-side KWS triage.

config RIVER_KWS_DIAG_LOG_EVERY_INFER
    bool "Wake-word KWS log every inference"
    default n
    depends on RIVER_KWS_DIAG_VERBOSE_EN
    depends on RIVER_VOICE_CAPABILITY_KWS
    help
      Force a detailed KWS diagnostic line on every inference. Keep this
      disabled for normal debug runs unless the repeated-pattern logs are
      still insufficient.

endmenu
```
